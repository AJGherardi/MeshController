## CMakeLists.txt
```
cmake_minimum_required(VERSION 3.13.1)
find_package(Zephyr)
project(mesh_controller)

FILE(GLOB app_sources src/*.c)
target_sources(app PRIVATE ${app_sources})
```

## prj.conf
```kconfig
CONFIG_MAIN_STACK_SIZE=1024
CONFIG_SYSTEM_WORKQUEUE_STACK_SIZE=2048

CONFIG_BT_OBSERVER=y
CONFIG_BT_BROADCASTER=y
CONFIG_BT_CTLR_DUP_FILTER_LEN=0
CONFIG_BT_CTLR_LE_ENC=n
CONFIG_BT_CTLR_LE_PING=n
CONFIG_BT_DATA_LEN_UPDATE=n
CONFIG_BT_PHY_UPDATE=n
CONFIG_BT_CTLR_CHAN_SEL_2=n
CONFIG_BT_CTLR_MIN_USED_CHAN=n
CONFIG_BT_CTLR_ADV_EXT=n
CONFIG_BT_CTLR_PRIVACY=n
CONFIG_BT_PERIPHERAL=y

CONFIG_BT=y
CONFIG_BT_TINYCRYPT_ECC=y
CONFIG_BT_L2CAP_RX_MTU=69
CONFIG_BT_L2CAP_TX_MTU=69
CONFIG_BT_L2CAP_TX_BUF_COUNT=8
CONFIG_BT_MESH=y
CONFIG_BT_MESH_RELAY=y
CONFIG_BT_MESH_LOW_POWER=n
CONFIG_BT_MESH_FRIEND=n
CONFIG_BT_MESH_FRIEND_QUEUE_SIZE=16
CONFIG_BT_MESH_ADV_BUF_COUNT=20
CONFIG_BT_MESH_TX_SEG_MSG_COUNT=3

CONFIG_BT_MESH_CFG_CLI=y
CONFIG_BT_MESH_HEALTH_CLI=y

CONFIG_BT_MESH_PROVISIONER=y
CONFIG_BT_MESH_CDB=y
CONFIG_BT_MESH_CDB_NODE_COUNT=2000
CONFIG_BT_MESH_CDB_SUBNET_COUNT=1
CONFIG_BT_MESH_CDB_APP_KEY_COUNT=2000

# CONFIG_BT_SETTINGS=y
# CONFIG_FLASH=y
# CONFIG_FLASH_PAGE_LAYOUT=y
# CONFIG_FLASH_MAP=y
# CONFIG_NVS=y
# CONFIG_SETTINGS=y
# CONFIG_BT_MESH_RPL_STORE_TIMEOUT=600

#CONFIG_BT_DEBUG_LOG=y

#CONFIG_BT_MESH_DEBUG=y
#CONFIG_BT_MESH_DEBUG_SETTINGS=y
#CONFIG_BT_MESH_DEBUG_NET=y
#CONFIG_BT_MESH_DEBUG_MODEL=y
#CONFIG_BT_MESH_DEBUG_TRANS=y
#CONFIG_BT_MESH_DEBUG_ACCESS=y
#CONFIG_BT_MESH_DEBUG_CRYPTO=y

CONFIG_USB=y
CONFIG_USB_DEVICE_STACK=y
CONFIG_USB_DEVICE_PRODUCT="Zephyr USB console sample"
CONFIG_USB_UART_CONSOLE=y

CONFIG_UART_INTERRUPT_DRIVEN=y
CONFIG_UART_LINE_CTRL=y
CONFIG_UART_CONSOLE_ON_DEV_NAME="CDC_ACM_0"

CONFIG_USB_UART_DTR_WAIT=y
```

## src/main.c
```c
#include <sys/printk.h>
#include <bluetooth/bluetooth.h>
#include <bluetooth/mesh.h>

#include "usb.h"
#include "mesh.h"

void main(void)
{
	// Init bluetooth
	bt_enable(NULL);
	bt_ready();
	// Init usb
	init_usb();
}
```

## src/composition.c
```c
#include "composition.h"
#include "mesh.h"
#include "usb.h"

static void gen_onoff_status(struct bt_mesh_model *model,
                             struct bt_mesh_msg_ctx *ctx,
                             struct net_buf_simple *buf);

static void scene_status(struct bt_mesh_model *model,
                         struct bt_mesh_msg_ctx *ctx,
                         struct net_buf_simple *buf);

static void scene_register_status(struct bt_mesh_model *model,
                                  struct bt_mesh_msg_ctx *ctx,
                                  struct net_buf_simple *buf);

static void event_status(struct bt_mesh_model *model,
                         struct bt_mesh_msg_ctx *ctx,
                         struct net_buf_simple *buf);

static struct bt_mesh_cfg_srv cfg_srv = {
    .relay = BT_MESH_RELAY_ENABLED,
    .beacon = BT_MESH_BEACON_DISABLED,
    .frnd = BT_MESH_FRIEND_NOT_SUPPORTED,
    .default_ttl = 7,
    .net_transmit = BT_MESH_TRANSMIT(2, 20),
    .relay_retransmit = BT_MESH_TRANSMIT(3, 20),
};

static struct bt_mesh_cfg_cli cfg_cli = {};

static const struct bt_mesh_model_op gen_onoff_srv_op[] = {
    BT_MESH_MODEL_OP_END,
};

static const struct bt_mesh_model_op gen_onoff_cli_op[] = {
    {BT_MESH_MODEL_OP_GEN_ONOFF_STATUS, 1, gen_onoff_status},
    BT_MESH_MODEL_OP_END,
};

static const struct bt_mesh_model_op scene_srv_op[] = {
    {BT_MESH_MODEL_OP_SCENE_STATUS, 0, scene_status},
    {BT_MESH_MODEL_OP_SCENE_REGISTER_STATUS, 0, scene_register_status},
    BT_MESH_MODEL_OP_END,
};

static const struct bt_mesh_model_op scene_setup_srv_op[] = {
    BT_MESH_MODEL_OP_END,
};

static const struct bt_mesh_model_op event_cli_op[] = {
    {BT_MESH_MODEL_OP_EVENT_STATUS, 0, event_status},
    BT_MESH_MODEL_OP_END,
};

static void gen_onoff_status(struct bt_mesh_model *model,
                             struct bt_mesh_msg_ctx *ctx,
                             struct net_buf_simple *buf)
{
    uint8_t state;
    uint16_t addr;
    state = net_buf_simple_pull_u8(buf);
    addr = ctx->addr;
    // Write state and addr to usb
    uint8_t write[3];
    write[0] = (addr);
    write[1] = (addr >> 8);
    write[2] = state;
    write_usb(usb, OP_STATE, write, 3);
}
static void scene_status(struct bt_mesh_model *model,
                         struct bt_mesh_msg_ctx *ctx,
                         struct net_buf_simple *buf)
{
}
static void scene_register_status(struct bt_mesh_model *model,
                                  struct bt_mesh_msg_ctx *ctx,
                                  struct net_buf_simple *buf)
{
}
static void event_status(struct bt_mesh_model *model,
                         struct bt_mesh_msg_ctx *ctx,
                         struct net_buf_simple *buf)
{
    uint16_t addr;
    addr = ctx->addr;
    uint8_t write[2];
    write[0] = (addr);
    write[1] = (addr >> 8);
    write_usb(usb, OP_EVENT, write, 2);
}

struct bt_mesh_model root_models[] = {
    BT_MESH_MODEL_CFG_SRV(&cfg_srv),
    BT_MESH_MODEL_CFG_CLI(&cfg_cli),
    BT_MESH_MODEL(BT_MESH_MODEL_ID_GEN_ONOFF_SRV, gen_onoff_srv_op,
                  NULL, NULL),
    BT_MESH_MODEL(BT_MESH_MODEL_ID_GEN_ONOFF_CLI, gen_onoff_cli_op,
                  NULL, NULL),
    BT_MESH_MODEL(BT_MESH_MODEL_ID_SCENE_SRV, scene_srv_op,
                  NULL, NULL),
    BT_MESH_MODEL(BT_MESH_MODEL_ID_SCENE_SETUP_SRV, scene_setup_srv_op,
                  NULL, NULL),
    BT_MESH_MODEL(BT_MESH_MODEL_ID_EVENT_SETUP_SRV, NULL,
                  NULL, NULL),
    BT_MESH_MODEL(BT_MESH_MODEL_ID_EVENT_CLI, event_cli_op,
                  NULL, NULL),
};

static struct bt_mesh_elem elements[] = {
    BT_MESH_ELEM(0, root_models, BT_MESH_MODEL_NONE),
};

const struct bt_mesh_comp comp = {
    .cid = BT_COMP_ID_LF,
    .elem = elements,
    .elem_count = ARRAY_SIZE(elements),
};
```

## src/composition.h
```c
#ifndef _COMPOSITION_H
#define _COMPOSITION_H

#include <zephyr.h>
#include <bluetooth/bluetooth.h>
#include <bluetooth/mesh.h>

extern const struct bt_mesh_comp comp;
extern struct bt_mesh_model root_models[];

#endif
```

## src/controller.c
```c
#include "controller.h"
#include "mesh.h"
#include "usb.h"

static uint16_t self_addr = 1;

void reboot()
{
    sys_reboot(SYS_REBOOT_WARM);
}

void reset()
{
    bt_mesh_reset();
    bt_mesh_cdb_clear();
}

void reset_node(uint16_t addr)
{
    write_mesh_config(addr);
}

void send_message(uint8_t state, uint16_t addr, uint16_t app_idx)
{
    write_mesh_state(state, addr, app_idx);
}

void send_recall_message(uint16_t scene_number, uint16_t addr, uint16_t app_idx)
{
    write_mesh_recall(scene_number, addr, app_idx);
}

void send_store_message(uint16_t scene_number, uint16_t addr, uint16_t app_idx)
{
    write_mesh_store(scene_number, addr, app_idx);
}

void send_delete_message(uint16_t scene_number, uint16_t addr, uint16_t app_idx)
{
    write_mesh_delete(scene_number, addr, app_idx);
}

void send_bind_message(uint16_t scene_number, uint16_t addr, uint16_t app_idx)
{
    write_mesh_bind(scene_number, addr, app_idx);
}

void configure_node(uint16_t addr, uint16_t app_idx)
{
    int err;
    struct bt_mesh_cdb_node *node;
    struct bt_mesh_cdb_app_key *key;
    // Get node from cdb
    node = bt_mesh_cdb_node_get(addr);
    if (node == NULL)
    {
        return;
    }
    // Get app key from cdb
    key = bt_mesh_cdb_app_key_get(app_idx);
    if (key == NULL)
    {
        return;
    }
    // Add app key to node
    err = bt_mesh_cfg_app_key_add(BT_MESH_NET_PRIMARY, node->addr, BT_MESH_NET_PRIMARY, key->app_idx,
                                  key->keys[0].app_key, NULL);
    if (err < 0)
    {
        return;
    }
    // Store node
    bt_mesh_cdb_node_store(node);
}

void configure_elem(uint16_t group_addr, uint16_t node_addr, uint16_t elem_addr, uint16_t app_idx)
{
    int err;
    struct bt_mesh_cdb_node *node;
    struct bt_mesh_cdb_app_key *key;
    // Get node from cdb
    node = bt_mesh_cdb_node_get(node_addr);
    if (node == NULL)
    {
        return;
    }
    // Get app key from cdb
    key = bt_mesh_cdb_app_key_get(app_idx);
    if (key == NULL)
    {
        return;
    }
    // Bind app key to elem
    err = bt_mesh_cfg_mod_app_bind(BT_MESH_NET_PRIMARY, node->addr, elem_addr, key->app_idx,
                                   BT_MESH_MODEL_ID_GEN_ONOFF_SRV, NULL);
    err = bt_mesh_cfg_mod_app_bind(BT_MESH_NET_PRIMARY, node->addr, elem_addr, key->app_idx,
                                   BT_MESH_MODEL_ID_SCENE_SRV, NULL);
    err = bt_mesh_cfg_mod_app_bind(BT_MESH_NET_PRIMARY, node->addr, elem_addr, key->app_idx,
                                   BT_MESH_MODEL_ID_SCENE_SETUP_SRV, NULL);
    err = bt_mesh_cfg_mod_app_bind(BT_MESH_NET_PRIMARY, node->addr, elem_addr, key->app_idx,
                                   BT_MESH_MODEL_ID_EVENT_SETUP_SRV, NULL);
    err = bt_mesh_cfg_mod_app_bind(BT_MESH_NET_PRIMARY, node->addr, elem_addr, key->app_idx,
                                   BT_MESH_MODEL_ID_EVENT_CLI, NULL);
    // Bind models to group addr
    err = bt_mesh_cfg_mod_sub_add(BT_MESH_NET_PRIMARY, node->addr, elem_addr, group_addr,
                                  BT_MESH_MODEL_ID_SCENE_SRV, NULL);
    err = bt_mesh_cfg_mod_sub_add(BT_MESH_NET_PRIMARY, node->addr, elem_addr, group_addr,
                                  BT_MESH_MODEL_ID_SCENE_SETUP_SRV, NULL);
    err = bt_mesh_cfg_mod_sub_add(BT_MESH_NET_PRIMARY, node->addr, elem_addr, group_addr,
                                  BT_MESH_MODEL_ID_EVENT_SETUP_SRV, NULL);
    err = bt_mesh_cfg_mod_sub_add(BT_MESH_NET_PRIMARY, node->addr, elem_addr, group_addr,
                                  BT_MESH_MODEL_ID_EVENT_CLI, NULL);
    if (err < 0)
    {
        return;
    }
    // Store node
    bt_mesh_cdb_node_store(node);
}

void provision(uint8_t uuid[16])
{
    int err;
    // Provision node with uuid
    err = bt_mesh_provision_adv(uuid, BT_MESH_NET_PRIMARY, 0, 0);
}

void add_key(uint16_t app_idx)
{
    int err;
    struct bt_mesh_cdb_node *self;
    struct bt_mesh_cdb_app_key *key;
    // Get self from cdb
    self = bt_mesh_cdb_node_get(self_addr);
    if (self == NULL)
    {
        return;
    }
    // Get ref to app key
    key = bt_mesh_cdb_app_key_alloc(BT_MESH_NET_PRIMARY, app_idx);
    if (key == NULL)
    {
        return;
    }
    // Set app key
    bt_rand(key->keys[0].app_key, 16);
    // Store app key
    bt_mesh_cdb_app_key_store(key);
    // Add app key to self
    err = bt_mesh_cfg_app_key_add(BT_MESH_NET_PRIMARY, self->addr, BT_MESH_NET_PRIMARY,
                                  key->app_idx, key->keys[0].app_key, NULL);
    if (err < 0)
    {
        return;
    }
    // Bind app key to self
    err = bt_mesh_cfg_mod_app_bind(BT_MESH_NET_PRIMARY, self->addr, self->addr, key->app_idx,
                                   BT_MESH_MODEL_ID_GEN_ONOFF_SRV, NULL);
    err = bt_mesh_cfg_mod_app_bind(BT_MESH_NET_PRIMARY, self->addr, self->addr, key->app_idx,
                                   BT_MESH_MODEL_ID_GEN_ONOFF_CLI, NULL);
    err = bt_mesh_cfg_mod_app_bind(BT_MESH_NET_PRIMARY, self->addr, self->addr, key->app_idx,
                                   BT_MESH_MODEL_ID_SCENE_SRV, NULL);
    err = bt_mesh_cfg_mod_app_bind(BT_MESH_NET_PRIMARY, self->addr, self->addr, key->app_idx,
                                   BT_MESH_MODEL_ID_SCENE_SETUP_SRV, NULL);
    err = bt_mesh_cfg_mod_app_bind(BT_MESH_NET_PRIMARY, self->addr, self->addr, key->app_idx,
                                   BT_MESH_MODEL_ID_EVENT_SETUP_SRV, NULL);
    err = bt_mesh_cfg_mod_app_bind(BT_MESH_NET_PRIMARY, self->addr, self->addr, key->app_idx,
                                   BT_MESH_MODEL_ID_EVENT_CLI, NULL);
    if (err < 0)
    {
        return;
    }
    // Store self
    bt_mesh_cdb_node_store(self);
    // Convert app key index and send
    uint8_t write[2];
    write[0] = (app_idx);
    write[1] = (app_idx >> 8);
    write_usb(usb, OP_ADD_KEY_STATUS, write, 2);
}

void setup()
{
    int err;
    // Generate dev key
    uint8_t dev_key[16], net_key[16];
    bt_rand(net_key, 16);
    bt_rand(dev_key, 16);
    // Create a config database
    err = bt_mesh_cdb_create(net_key);
    if (err)
    {
        return;
    }
    // Provision self
    err = bt_mesh_provision(net_key, BT_MESH_NET_PRIMARY, 0, 0, 0,
                            dev_key);
    if (err)
    {
        return;
    }
    // Convert addr and send
    uint8_t write[2];
    write[0] = (self_addr);
    write[1] = (self_addr >> 8);
    write_usb(usb, OP_SETUP_STATUS, write, 2);
}
```

## src/controller.h
```c
#ifndef _CONTROLLER_H
#define _CONTROLLER_H

#include <zephyr.h>
#include <bluetooth/bluetooth.h>
#include <bluetooth/mesh.h>
#include <power/reboot.h>

void setup();
void add_key(uint16_t app_idx);
void provision(uint8_t uuid[16]);
void configure_node(uint16_t addr, uint16_t app_idx);
void configure_elem(uint16_t group_addr, uint16_t node_addr, uint16_t elem_addr, uint16_t app_idx);
void reset_node(uint16_t addr);
void send_message(uint8_t state, uint16_t addr, uint16_t app_idx);
void send_recall_message(uint16_t scene_number, uint16_t addr, uint16_t app_idx);
void send_store_message(uint16_t scene_number, uint16_t addr, uint16_t app_idx);
void send_delete_message(uint16_t scene_number, uint16_t addr, uint16_t app_idx);
void send_bind_message(uint16_t scene_number, uint16_t addr, uint16_t app_idx);
void reset();
void reboot();

#endif
```

## src/mesh.c
```c
#include "mesh.h"
#include "usb.h"
#include "composition.h"
#include "controller.h"

static void unprovisioned_beacon(uint8_t uuid[16], bt_mesh_prov_oob_info_t oob_info, uint32_t *uri_hash)
{
    // Write uuid to usb
    write_usb(usb, OP_UNPROVISIONED_BEACON, uuid, 16);
}

static void node_added(uint16_t net_idx, uint8_t uuid[16], uint16_t addr, uint8_t num_elem)
{
    // Convert addr and send
    uint8_t write[2];
    write[0] = (addr);
    write[1] = (addr >> 8);
    write_usb(usb, OP_NODE_ADDED, write, 2);
}

static void prov_reset(void)
{
    printk("test");
}

static uint8_t dev_uuid[16] = {0xdd, 0xdd};

static const struct bt_mesh_prov prov = {
    .uuid = dev_uuid,
    .unprovisioned_beacon = unprovisioned_beacon,
    .node_added = node_added,
    .reset = prov_reset,
};

void bt_ready(void)
{
    struct bt_le_oob oob;
    int err;
    // Init bluetooth mesh
    err = bt_mesh_init(&prov, &comp);
    // Load data from flash
    settings_load();
    // Use Nordic FICR as UUID
    if (!bt_le_oob_get_local(BT_ID_DEFAULT, &oob))
    {
        memcpy(dev_uuid, oob.addr.a.val, 6);
    }
}

void write_mesh_bind(uint16_t scene_number, uint16_t node_addr, uint16_t app_idx)
{
    // Make msg buffer
    NET_BUF_SIMPLE_DEFINE(msg, 2 + 6 + 4);
    // Define msg context
    struct bt_mesh_msg_ctx ctx = {
        .net_idx = BT_MESH_NET_PRIMARY,
        .app_idx = app_idx,
        .addr = node_addr,
        .send_ttl = BT_MESH_TTL_DEFAULT,
    };
    // Add paylode to buffer
    bt_mesh_model_msg_init(&msg, BT_MESH_MODEL_OP_EVENT_BIND);
    net_buf_simple_add_le16(&msg, scene_number);
    bt_mesh_model_send(&root_models[6], &ctx, &msg, NULL, NULL);
}

void write_mesh_state(uint8_t state, uint16_t node_addr, uint16_t app_idx)
{
    // Make msg buffer
    NET_BUF_SIMPLE_DEFINE(msg, 2 + 6);
    // Define msg context
    struct bt_mesh_msg_ctx ctx = {
        .net_idx = BT_MESH_NET_PRIMARY,
        .app_idx = app_idx,
        .addr = node_addr,
        .send_ttl = BT_MESH_TTL_DEFAULT,
    };
    // Add paylode to buffer
    bt_mesh_model_msg_init(&msg, BT_MESH_MODEL_OP_GEN_ONOFF_SET);
    net_buf_simple_add_u8(&msg, state);
    net_buf_simple_add_u8(&msg, 1);
    bt_mesh_model_send(&root_models[2], &ctx, &msg, NULL, NULL);
}

void write_mesh_store(uint16_t scene_number, uint16_t node_addr, uint16_t app_idx)
{
    // Make msg buffer
    NET_BUF_SIMPLE_DEFINE(msg, 2 + 6);
    // Define msg context
    struct bt_mesh_msg_ctx ctx = {
        .net_idx = BT_MESH_NET_PRIMARY,
        .app_idx = app_idx,
        .addr = node_addr,
        .send_ttl = BT_MESH_TTL_DEFAULT,
    };
    // Add paylode to buffer
    bt_mesh_model_msg_init(&msg, BT_MESH_MODEL_OP_SCENE_STORE);
    net_buf_simple_add_le16(&msg, scene_number);
    bt_mesh_model_send(&root_models[5], &ctx, &msg, NULL, NULL);
}

void write_mesh_recall(uint16_t scene_number, uint16_t node_addr, uint16_t app_idx)
{
    // Make msg buffer
    NET_BUF_SIMPLE_DEFINE(msg, 2 + 6 + 4);
    // Define msg context
    struct bt_mesh_msg_ctx ctx = {
        .net_idx = BT_MESH_NET_PRIMARY,
        .app_idx = app_idx,
        .addr = node_addr,
        .send_ttl = BT_MESH_TTL_DEFAULT,
    };
    // Add paylode to buffer
    bt_mesh_model_msg_init(&msg, BT_MESH_MODEL_OP_SCENE_RECALL);
    net_buf_simple_add_le16(&msg, scene_number);
    net_buf_simple_add_u8(&msg, 1);
    bt_mesh_model_send(&root_models[4], &ctx, &msg, NULL, NULL);
}

void write_mesh_delete(uint16_t scene_number, uint16_t node_addr, uint16_t app_idx)
{
    // Make msg buffer
    NET_BUF_SIMPLE_DEFINE(msg, 2 + 6);
    // Define msg context
    struct bt_mesh_msg_ctx ctx = {
        .net_idx = BT_MESH_NET_PRIMARY,
        .app_idx = app_idx,
        .addr = node_addr,
        .send_ttl = BT_MESH_TTL_DEFAULT,
    };
    // Add paylode to buffer
    bt_mesh_model_msg_init(&msg, BT_MESH_MODEL_OP_SCENE_DELETE);
    net_buf_simple_add_le16(&msg, scene_number);
    bt_mesh_model_send(&root_models[5], &ctx, &msg, NULL, NULL);
}

void write_mesh_config(uint16_t node_addr)
{
    // Make msg buffer
    NET_BUF_SIMPLE_DEFINE(msg, 2 + 4);
    // Define msg context
    struct bt_mesh_msg_ctx ctx = {
        .app_idx = BT_MESH_KEY_DEV_REMOTE,
        .addr = node_addr,
        .send_ttl = BT_MESH_TTL_DEFAULT,
    };
    // Add paylode to buffer
    bt_mesh_model_msg_init(&msg, BT_MESH_MODEL_OP_CONFIG_NODE_RESET);
    bt_mesh_model_send(&root_models[1], &ctx, &msg, NULL, NULL);
}
```

## src/mesh.h
```c
#ifndef _MESH_H
#define _MESH_H

#include <bluetooth/bluetooth.h>
#include <bluetooth/conn.h>
#include <bluetooth/l2cap.h>
#include <bluetooth/hci.h>
#include <bluetooth/mesh.h>

// Model IDs
#define BT_MESH_MODEL_ID_EVENT_SETUP_SRV 0x1312
#define BT_MESH_MODEL_ID_EVENT_CLI 0x1313
// Op codes
#define BT_MESH_MODEL_OP_GEN_ONOFF_SET BT_MESH_MODEL_OP_2(0x82, 0x02)
#define BT_MESH_MODEL_OP_GEN_ONOFF_SET_UNACK BT_MESH_MODEL_OP_2(0x82, 0x03)
#define BT_MESH_MODEL_OP_CONFIG_NODE_RESET BT_MESH_MODEL_OP_2(0x80, 0x49)
#define BT_MESH_MODEL_OP_GEN_ONOFF_STATUS BT_MESH_MODEL_OP_2(0x82, 0x04)
#define BT_MESH_MODEL_OP_SCENE_GET BT_MESH_MODEL_OP_2(0x82, 0x41)
#define BT_MESH_MODEL_OP_SCENE_RECALL BT_MESH_MODEL_OP_2(0x82, 0x42)
#define BT_MESH_MODEL_OP_SCENE_RECALL_UNACK BT_MESH_MODEL_OP_2(0x82, 0x43)
#define BT_MESH_MODEL_OP_SCENE_STATUS BT_MESH_MODEL_OP_1(0x5E)
#define BT_MESH_MODEL_OP_SCENE_REGISTER_GET BT_MESH_MODEL_OP_2(0x82, 0x44)
#define BT_MESH_MODEL_OP_SCENE_REGISTER_STATUS BT_MESH_MODEL_OP_2(0x82, 0x45)
#define BT_MESH_MODEL_OP_SCENE_STORE BT_MESH_MODEL_OP_2(0x82, 0x46)
#define BT_MESH_MODEL_OP_SCENE_STORE_UNACK BT_MESH_MODEL_OP_2(0x82, 0x47)
#define BT_MESH_MODEL_OP_SCENE_DELETE BT_MESH_MODEL_OP_2(0x82, 0x9E)
#define BT_MESH_MODEL_OP_SCENE_DELETE_UNACK BT_MESH_MODEL_OP_2(0x82, 0x9F)
#define BT_MESH_MODEL_OP_EVENT_BIND BT_MESH_MODEL_OP_2(0x82, 0xAA)
#define BT_MESH_MODEL_OP_EVENT_STATUS BT_MESH_MODEL_OP_2(0x82, 0xAB)

void bt_ready(void);
void write_mesh_state(uint8_t state, uint16_t node_addr, uint16_t app_idx);
void write_mesh_bind(uint16_t scene_number, uint16_t node_addr, uint16_t app_idx);
void write_mesh_store(uint16_t scene_number, uint16_t node_addr, uint16_t app_idx);
void write_mesh_recall(uint16_t scene_number, uint16_t node_addr, uint16_t app_idx);
void write_mesh_delete(uint16_t scene_number, uint16_t node_addr, uint16_t app_idx);
void write_mesh_config(uint16_t node_addr);
void setup_cdb(void);

#endif
```

## src/usb.c
```c
#include "usb.h"
#include "controller.h"

struct device *usb;

static void handler(struct device *dev)
{
    // Process interrupts
    uart_irq_update(dev);
    // Return if not ready
    if (!uart_irq_rx_ready(dev))
    {
        return;
    }
    // Read into buffer
    uint8_t buffer[32];
    uart_fifo_read(dev, buffer, 32);
    // Map to appropriate function
    switch (buffer[0])
    {
    case OP_SETUP:
    {
        setup();
        break;
    }
    case OP_ADD_KEY:
    {
        uint16_t app_idx = join2(buffer[1], buffer[2]);
        add_key(app_idx);
        break;
    }
    case OP_PROVISION:
    {
        uint8_t uuid[16] = {};
        memcpy(uuid, buffer + 1, 16);
        provision(uuid);
        break;
    }
    case OP_CONFIGURE_NODE:
    {
        uint16_t addr = join2(buffer[1], buffer[2]);
        uint16_t app_idx = join2(buffer[3], buffer[4]);
        configure_node(addr, app_idx);
        break;
    }
    case OP_CONFIGURE_ELEM:
    {
        uint16_t group_addr = join2(buffer[1], buffer[2]);
        uint16_t node_addr = join2(buffer[3], buffer[4]);
        uint16_t elem_addr = join2(buffer[5], buffer[6]);
        uint16_t app_idx = join2(buffer[7], buffer[8]);
        configure_elem(group_addr, node_addr, elem_addr, app_idx);
        break;
    }
    case OP_SEND_MESSAGE:
    {
        uint16_t addr = join2(buffer[2], buffer[3]);
        uint16_t app_idx = join2(buffer[4], buffer[5]);
        send_message(buffer[1], addr, app_idx);
        break;
    }
    case OP_SEND_RECALL_MESSAGE:
    {
        uint16_t scene_number = join2(buffer[1], buffer[2]);
        uint16_t addr = join2(buffer[3], buffer[4]);
        uint16_t app_idx = join2(buffer[5], buffer[6]);
        send_recall_message(scene_number, addr, app_idx);
        break;
    }
    case OP_SEND_STORE_MESSAGE:
    {
        uint16_t scene_number = join2(buffer[1], buffer[2]);
        uint16_t addr = join2(buffer[3], buffer[4]);
        uint16_t app_idx = join2(buffer[5], buffer[6]);
        send_store_message(scene_number, addr, app_idx);
        break;
    }
    case OP_SEND_DELETE_MESSAGE:
    {
        uint16_t scene_number = join2(buffer[1], buffer[2]);
        uint16_t addr = join2(buffer[3], buffer[4]);
        uint16_t app_idx = join2(buffer[5], buffer[6]);
        send_delete_message(scene_number, addr, app_idx);
        break;
    }
    case OP_SEND_BIND_MESSAGE:
    {
        uint16_t scene_number = join2(buffer[1], buffer[2]);
        uint16_t addr = join2(buffer[3], buffer[4]);
        uint16_t app_idx = join2(buffer[5], buffer[6]);
        send_bind_message(scene_number, addr, app_idx);
        break;
    }
    case OP_RESET:
    {
        reset();
        break;
    }
    case OP_REBOOT:
    {
        reboot();
        break;
    }
    case OP_NODE_RESET:
    {
        uint16_t addr = join2(buffer[1], buffer[2]);
        reset_node(addr);
        break;
    }
    }
}

uint16_t join2(uint8_t d1, uint8_t d2)
{
    uint16_t output;
    union
    {
        uint8_t bytes[2];
        uint16_t n;
    } join;
    join.bytes[0] = d1;
    join.bytes[1] = d2;
    output = join.n;
    return output;
}

uint32_t join4(uint8_t d1, uint8_t d2, uint8_t d3, uint8_t d4)
{
    uint32_t output;
    union
    {
        uint8_t bytes[4];
        uint32_t n;
    } join;
    join.bytes[0] = d1;
    join.bytes[1] = d2;
    join.bytes[2] = d3;
    join.bytes[3] = d4;
    output = join.n;
    return output;
}

void write_usb(struct device *dev, uint8_t op, uint8_t *buf, int len)
{
    if (!uart_irq_tx_ready(dev))
    {
        return;
    }
    static uint8_t write[32] = {};
    // Set op code
    write[0] = op;
    // Copy buffer
    memcpy(write + 1, buf, len);
    // Write to uart
    uart_fifo_fill(dev, write, (len + 1));
}

void init_usb(void)
{
    // Get cdc device
    usb = device_get_binding("CDC_ACM_0");
    // Enable usb
    usb_enable(NULL);
    // Set callback
    uart_irq_callback_set(usb, handler);
    // Enable interrupts
    uart_irq_rx_enable(usb);
    uart_irq_tx_enable(usb);
}
```

## src/usb.h
```c
#ifndef _USB_H
#define _USB_H

#include <usb/usb_device.h>
#include <drivers/uart.h>

// Define usb op codes
#define OP_SETUP 0x00
#define OP_SETUP_STATUS 0x01
#define OP_ADD_KEY 0x02
#define OP_ADD_KEY_STATUS 0x03
#define OP_UNPROVISIONED_BEACON 0x04
#define OP_PROVISION 0x05
#define OP_NODE_ADDED 0x06
#define OP_CONFIGURE_NODE 0x07
#define OP_CONFIGURE_NODE_STATUS 0x08
#define OP_SEND_MESSAGE 0x09
#define OP_RESET 0x10
#define OP_REBOOT 0x11
#define OP_NODE_RESET 0x12
#define OP_STATE 0x13
#define OP_CONFIGURE_ELEM 0x14
#define OP_CONFIGURE_ELEM_STATUS 0x15
#define OP_SEND_RECALL_MESSAGE 0x16
#define OP_SEND_STORE_MESSAGE 0x17
#define OP_SEND_DELETE_MESSAGE 0x18
#define OP_SEND_BIND_MESSAGE 0x19
#define OP_EVENT 0x20

extern struct device *usb;

void write_usb(struct device *dev, uint8_t op, uint8_t *buf, int len);
void init_usb(void);
uint8_t *slice(uint8_t *source, size_t offset, size_t count);
uint16_t join2(uint8_t d1, uint8_t d2);
uint32_t join4(uint8_t d1, uint8_t d2, uint8_t d3, uint8_t d4);

#endif
```
